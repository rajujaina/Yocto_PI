## meta-raspi-custom/conf/layer.conf
```bitbake
# Layer configuration for meta-raspi-custom
BBPATH .= ":${LAYERDIR}"

# We have recipes in these directories, add to BBFILES
BBFILES += "${LAYERDIR}/recipes-*/*/*.bb \
            ${LAYERDIR}/recipes-*/*/*.bbappend"

BBFILE_COLLECTIONS += "meta-raspi-custom"
BBFILE_PATTERN_meta-raspi-custom = "^${LAYERDIR}/"
BBFILE_PRIORITY_meta-raspi-custom = "10"

# Layer dependencies
LAYERDEPENDS_meta-raspi-custom = "core raspberrypi"

# Layer series compatibility
LAYERSERIES_COMPAT_meta-raspi-custom = "kirkstone"

# Layer description
LAYERSERIES_CORENAMES_meta-raspi-custom = "meta-raspi-custom"
```
